## smokeping/smokeping.d/local/share/cook/templates/config.in
```kconfig
*** General ***

owner    = Potluck Smokeping
contact  = %%email%%
mailhost = %%mailhost%%
sendmail = /usr/sbin/sendmail
# NOTE: do not put the Image Cache below cgi-bin
# since all files under cgi-bin will be executed ... this is not
# good for images.
imgcache = /mnt/smokeping/imagecache
imgurl   = cache
datadir  = /mnt/smokeping/data
piddir  = /usr/local/var
cgiurl   = http://%%hostname%%/smokeping.cgi
smokemail = /usr/local/etc/smokeping/smokemail.sample
tmail = /usr/local/etc/smokeping/tmail.sample
# specify this to get syslog logging
syslogfacility = local0
# each probe is now run in its own process
# disable this to revert to the old behaviour
# concurrentprobes = no

*** Alerts ***
to = %%alertemail%%
from = %%email%%

+someloss
type = loss
# in percent
pattern = >0%,*12*,>0%,*12*,>0%
comment = loss 3 times  in a row

*** Database ***

step     = 300
pings    = 20

# consfn mrhb steps total

AVERAGE  0.5   1  28800
AVERAGE  0.5  12   9600
    MIN  0.5  12   9600
    MAX  0.5  12   9600
AVERAGE  0.5 144   2400
    MAX  0.5 144   2400
    MIN  0.5 144   2400

*** Presentation ***

template = /usr/local/etc/smokeping/basepage.html.sample
htmltitle = yes
graphborders = no

+ charts

menu = Charts
title = The most interesting destinations

++ stddev
sorter = StdDev(entries=>4)
title = Top Standard Deviation
menu = Std Deviation
format = Standard Deviation %f

++ max
sorter = Max(entries=>5)
title = Top Max Roundtrip Time
menu = by Max
format = Max Roundtrip Time %f seconds

++ loss
sorter = Loss(entries=>5)
title = Top Packet Loss
menu = Loss
format = Packets Lost %f

++ median
sorter = Median(entries=>5)
title = Top Median Roundtrip Time
menu = by Median
format = Median RTT %f seconds

+ overview 

width = 600
height = 50
range = 10h

+ detail

width = 600
height = 200
unison_tolerance = 2

"Last 3 Hours"    3h
"Last 30 Hours"   30h
"Last 10 Days"    10d
"Last 360 Days"   360d

*** Probes ***

+ FPing

binary = /usr/local/sbin/fping

*** Targets ***

probe = FPing

menu = Top
title = Network Latency Grapher
remark = Welcome to the SmokePing. \
         Here you will learn all about the latency of our network.

+TopLevel
menu = Top Level
title = top level categories

++News
menu = News
title = New hosts

+++BBC
menu = BBC
title = BBC
host = bbc.com

++ CNBC
menu = CNBC
title = CNBC
host = cnbc.com

+++CNN
menu = CNN
title = CNN
host = cnn.com

++Search
menu = Search
title = Search sites

+++Bing
menu = Bing
title = Bing Search
host = bing.com

+++Google
menu = Google
title = Google Search
host = google.com

+++ Youtube
menu = Youtube
title = Youtube
host = youtube.com
```
